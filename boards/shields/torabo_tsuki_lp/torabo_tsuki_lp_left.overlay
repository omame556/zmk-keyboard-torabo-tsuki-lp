#include "torabo_tsuki_lp.dtsi"
#include <input/processors.dtsi>
#include <dt-bindings/zmk/input_transform.h>

/ {
    trackpad_listener: trackpad_listener {
        compatible = "zmk,input-listener";
        device = <&trackpad>;
        input-processors = <
            &zip_xy_to_scroll_mapper INPUT_REL_WHEEL INPUT_REL_HWHEEL
            &zip_scroll_transform (INPUT_TRANSFORM_Y_INVERT)
            &zip_scroll_scaler 1 1
        >;
    };
};

&pointing_listener {
    input-processors = <&zip_xy_transform (INPUT_TRANSFORM_X_INVERT | INPUT_TRANSFORM_Y_INVERT)>;
};
